## src/boards/Kconfig
```kconfig
# Board Hardware Configuration
# Sourced from: src/boards/

menu "Pin Configuration"
    config TUYA_AI_TOY_AUDIO_TRIGGER_PIN_NUM
        int "Audio trigger GPIO pin number (64=disabled)"
        default 12 if T5AI_BOARD || T5AI_BOARD_EYES || T2AI_BOARD
        default 28 if T5AI_BOARD_DESKTOP
        default 4  if T5AI_BOARD_EVB
        default 6  if T5AI_BOARD_EVB_PRO
        default 5  if T5AI_BOARD_ROBOT || LE270AI_BOARD
        default 25 if L511_Y6E_BOARD || L511_Y7PM_BOARD
        default 64
        range 0 64
        help
          音频触发按键GPIO编号，按下触发对话。设为64表示禁用

    config TUYA_AI_TOY_SPK_EN_PIN_NUM
        int "Speaker enable GPIO pin number"
        default 28 if T5AI_BOARD || T5AI_BOARD_EYES || T2AI_BOARD || LE270AI_BOARD
        default 19 if T5AI_BOARD_EVB
        default 64 if L511_Y6E_BOARD || L511_Y7PM_BOARD
        default 26
        range 0 64
        help
          喇叭功放使能引脚，控制扬声器开关

    config TUYA_AI_TOY_LED_PIN_NUM
        int "LED GPIO pin number (64=disabled)"
        default 56 if T5AI_BOARD || T2AI_BOARD || LE270AI_BOARD
        default 16 if L511_Y6E_BOARD || L511_Y7PM_BOARD
        default 8  if T5AI_BOARD_EVB
        default 25 if T5AI_BOARD_EVB_PRO
        default 64
        range 0 64
        help
          状态指示LED引脚。设为64表示禁用

    config TUYA_AI_TOY_NET_PIN_NUM
        int "Network indicator GPIO pin number (64=disabled)"
        default 12 if T5AI_BOARD_EVB
        default 7  if T5AI_BOARD_EVB_PRO
        default 4  if T5AI_BOARD_ROBOT
        default 64
        range 0 64
        help
          网络状态指示灯引脚。设为64表示禁用

    menuconfig DEVICE_POWER_CONTROL
        bool "Enable device power on/off control"
        default y if T5AI_BOARD_DESKTOP
        default n
        help
          启用设备电源开关机控制（长按关机等），桌面版默认开启

    if DEVICE_POWER_CONTROL
        config DEVICE_POWER_NET_KEY_PIN_NUM
            int "Power net key GPIO"
            default 3
            range 0 64
            help
              电源/网络按键引脚
        config DEVICE_POWER_PIN_NUM
            int "Device power GPIO"
            default 4
            range 0 64
            help
              设备电源锁存控制引脚
    endif
endmenu

# 显示总开关，顶替原 menu "Display Configuration"：LCD 面板驱动栈
# (tal_display/tdd_lcd_driver/tuya_display_hw) + 显示消息总线(tuya_ai_display)。
# 与 UI 框架解耦——ENABLE_TUYA_UI 依赖本开关；无 LVGL 的板(如 EYES 直推 GRAM)
# 只开本开关即可收到 EMOJI/CHAT_STAT 上报。原菜单下级配置项直接挂在本开关下。
menuconfig ENABLE_TUYA_DISPLAY
    bool "Display Configuration"
    select TUYA_MULTI_TYPES_LCD
    select TUYA_APP_DRIVERS_TP
    default n
    help
      启用显示硬件驱动栈与显示消息总线，并展开 LCD 面板参数配置。
      UI 框架(ENABLE_TUYA_UI)依赖本开关；不启用 UI 框架时业务侧仍可通过
      tuya_ai_display_msg 上报表情/对话状态，由板级自有渲染通路
      (如 EYES 的 TEF 播放器)消费。

if ENABLE_TUYA_DISPLAY

    config TUYA_LCD_IC_NAME_STR
        string "LCD IC driver name"
        default "ili9488"       if T5AI_BOARD || T2AI_BOARD || WUKONG_BOARD_QEMU_M33
        default "spi_st7789v2"  if T5AI_BOARD_DESKTOP
        default "spi_st7789"    if T5AI_BOARD_EVB || T5AI_BOARD_EVB_PRO
        default "spi_st7735s"   if T5AI_BOARD_EYES
        default "spi_st7789p3"  if T5AI_BOARD_ROBOT
        default "spi_jb9853a"   if L511_Y7PM_BOARD
        default ""
        help
          LCD屏幕驱动IC型号，需与硬件匹配

    config TUYA_LCD_WIDTH_VAL
        int "LCD width in pixels"
        default 320 if T5AI_BOARD || T2AI_BOARD || T5AI_BOARD_DESKTOP || T5AI_BOARD_ROBOT || WUKONG_BOARD_QEMU_M33
        default 284 if L511_Y7PM_BOARD
        default 240 if T5AI_BOARD_EVB || T5AI_BOARD_EVB_PRO
        default 128 if T5AI_BOARD_EYES
        default 0
        help
          LCD水平分辨率（像素），0表示无屏幕

    config TUYA_LCD_HEIGHT_VAL
        int "LCD height in pixels"
        default 480 if T5AI_BOARD || T2AI_BOARD || WUKONG_BOARD_QEMU_M33
        default 240 if T5AI_BOARD_DESKTOP || T5AI_BOARD_EVB || T5AI_BOARD_EVB_PRO || L511_Y7PM_BOARD
        default 128 if T5AI_BOARD_EYES
        default 172 if T5AI_BOARD_ROBOT
        default 0
        help
          LCD垂直分辨率（像素），0表示无屏幕

    config LCD_FPS_VAL
        int "LCD refresh FPS"
        default 20 if L511_Y7PM_BOARD
        default 15 if T5AI_BOARD_DESKTOP || T5AI_BOARD_EVB || T5AI_BOARD_EVB_PRO
        default 10
        range 1 60
        help
          LCD刷新帧率，值越高越流畅但CPU占用越高

    config TUYA_LCD_ROTATION_VAL
        int "LCD rotation (0=0, 1=90, 2=180, 3=270)"
        default 1 if L511_Y7PM_BOARD
        default 0
        range 0 3
        help
          屏幕旋转角度：0=不旋转，1=90度，2=180度，3=270度

    config LCD_SPI_DEVICE_NUM
        int "LCD SPI device number"
        depends on T5AI_BOARD_EYES
        default 1
        help
          LCD使用的SPI设备编号（眼睛板使用SPI1）

endif # ENABLE_TUYA_DISPLAY

# 驱动源码文件级门控宏(经 tuya_app_config.h 生成无前缀宏，被 tdd_lcd_driver /
# tdd_tp_driver 使用)。原挂在 ui/Kconfig 的 ENABLE_TUYA_UI 下，随显示解耦迁于此。
config TUYA_MULTI_TYPES_LCD
    bool
    default n

config TUYA_APP_DRIVERS_TP
    bool
    default n
```

## src/drivers/app_tuya_camera/Kconfig
```kconfig
# Camera Configuration
# Sourced from: src/drivers/app_tuya_camera/

if T5AI_BOARD || T5AI_BOARD_EYES || T5AI_BOARD_ROBOT || T5AI_BOARD_EVB_PRO || T5AI_BOARD_DESKTOP
    menuconfig ENABLE_TUYA_CAMERA
        bool "Enable camera"
        default n
        select TUYA_DMA2D_SHARE
        help
          启用摄像头功能，支持DVP和UVC两种接口。机器人板默认开启

    if ENABLE_TUYA_CAMERA
        config ENABLE_AI_MODE_P2P
            bool "Enable P2P video chat mode"
            default n
            help
              启用P2P视频对讲模式

        menu "Camera Hardware Configuration"
            choice
                prompt "Camera interface type"
                default CAMERA_TYPE_UVC if T5AI_BOARD_ROBOT
                default CAMERA_TYPE_DVP

                config CAMERA_TYPE_DVP
                    bool "DVP"
                    help
                      数字视频并行接口，适用于大多数板型
                config CAMERA_TYPE_UVC
                    bool "UVC"
                    help
                      USB视频类接口，适用于机器人板等USB摄像头场景
            endchoice

            config TUYA_AI_TOY_ISP_WIDTH_VAL
                int "Camera ISP capture width"
                default 320 if T5AI_BOARD_ROBOT
                default 480
                help
                  摄像头ISP采集宽度（像素）

            config TUYA_AI_TOY_ISP_HEIGHT_VAL
                int "Camera ISP capture height"
                default 240 if T5AI_BOARD_ROBOT
                default 480
                help
                  摄像头ISP采集高度（像素）

            config TUYA_AI_TOY_ISP_FPS_VAL
                int "Camera ISP FPS"
                default 15 if T5AI_BOARD_ROBOT
                default 10
                range 1 30
                help
                  摄像头采集帧率

            config TUYA_AI_TOY_POWER_PIN_NUM
                int "Camera power GPIO (64=none)"
                default 51 if T5AI_BOARD || T5AI_BOARD_EYES
                default 6  if T5AI_BOARD_ROBOT
                default 64
                range 0 64
                help
                  摄像头电源控制引脚，设为64表示无需控制

            config TUYA_AI_TOY_I2C_CLK_PIN_NUM
                int "Camera I2C CLK GPIO (64=none)"
                default 13 if T5AI_BOARD || T5AI_BOARD_EYES
                default 64
                range 0 64
                help
                  摄像头I2C时钟引脚（DVP接口使用）

            config TUYA_AI_TOY_I2C_SDA_PIN_NUM
                int "Camera I2C SDA GPIO (64=none)"
                default 15 if T5AI_BOARD || T5AI_BOARD_EYES
                default 64
                range 0 64
                help
                  摄像头I2C数据引脚（DVP接口使用）
        endmenu
    endif
endif
```
