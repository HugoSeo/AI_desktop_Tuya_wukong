## src/miscs/tuya_avi_service/Kconfig
```kconfig
menuconfig ENABLE_TY_AVI_MEDIA
    bool "Enable local AVI recording and playback"
    depends on TUYA_MODULE_T5
    depends on ENABLE_TUYA_CAMERA
    depends on ENABLE_TAL_IMAGE
    depends on WUKONG_STORAGE_SDCARD
    default n
    help
      Enable video-only MJPEG AVI recording through the shared Wukong camera
      service and callback playback through the Demo UI. Storage mounting,
      directory listing and path management remain owned by the Demo storage
      and filesystem services; AVI media does not own microphone, speaker or
      display hardware.
```

## src/wukong/mcp/Kconfig
```kconfig
# MCP Toolkits Configuration
# Sourced from: src/wukong/mcp/

menuconfig ENABLE_TUYA_TOOLKITS
    bool "Enable MCP toolkits"
    help
      启用MCP工具集，为AI提供设备控制和扩展能力

if ENABLE_TUYA_TOOLKITS
    if ENABLE_TUYA_CAMERA
        config ENABLE_TOOLKITS_CAMERA
            bool "Camera toolkit"
            default n
            help
              AI可调用摄像头进行拍照/识别
    endif
    if T5AI_BOARD_ROBOT
        config ENABLE_TOOLKITS_MOTION
            bool "Motion control toolkit"
            default n
            help
              AI可控制机器人运动（仅机器人板）
    endif
    if T5AI_BOARD_DESKTOP
        config ENABLE_APP_MOTION_ROTATION_MCP
            bool "Motion rotation toolkit"
            default y
            help
              启用旋转/运动传感器MCP工具（仅桌面版）
    endif
    config ENABLE_TOOLKITS_TM
        bool "Time management toolkit"
        default n
        help
          AI可进行时间管理（日程、提醒等）
    config ENABLE_TOOLKITS_CONTROL
        bool "Device control toolkit"
        default y
        help
          AI可控制设备基础功能（音量、亮度等）
    config ENABLE_TOOLKITS_PLAYBACK
        bool "Audio playback toolkit"
        default n
        help
          AI可控制音频播放（播放、暂停、切换等）
    config ENABLE_TOOLKITS_IMM
        bool "Instant messaging toolkit"
        default n
        help
          AI可进行即时通讯（发送消息等）
    config ENABLE_TOOLKITS_SOCIAL
        bool "Social interaction toolkit"
        default n
        help
          AI可使用社交功能（好友互动等）
endif
```

## src/wukong/picture/Kconfig
```kconfig
# AI Picture Configuration
# Sourced from: src/wukong/picture/

if ENABLE_AI_MODE_PICTURE
    menuconfig ENABLE_TUYA_PICTURE
        bool "Enable AI picture"
        select ENABLE_IMAGE_ALBUM
        default y
        help
          启用AI绘图功能，并自动启用图片相册、图像处理组件

    if ENABLE_TUYA_PICTURE
        config TUYA_PICTURE_ALBUM_NAME
            string "Picture album name"
            default "ai_picture"
            help
              图片相册名称

        config TUYA_PICTURE_ALBUM_MAX_IMAGE_CNT
            int "Max image count in album"
            default 10
            help
              相册中最大图片数量

        config TUYA_PICTURE_DEF_OUTPUT_WIDTH
            int "Default output width (pixels)"
            default TUYA_LCD_WIDTH_VAL
            help
              AI绘图默认输出宽度，默认与LCD宽度一致

        config TUYA_PICTURE_DEF_OUTPUT_HEIGHT
            int "Default output height (pixels)"
            default TUYA_LCD_HEIGHT_VAL
            help
              AI绘图默认输出高度，默认与LCD高度一致

        config ENABLE_TAL_IMAGE
            bool "Enable tal_image (JPEG decode / YUV / scale)"
            default y
            help
              启用图像处理库（JPEG解码、YUV转换、缩放）

        menuconfig ENABLE_IMAGE_ALBUM
            bool "Enable image album"
            select ENABLE_TAL_IMAGE
            default y
            help
              启用图片相册组件，用于图片存储和管理

        if ENABLE_IMAGE_ALBUM
            config ENABLE_IMAGE_ALBUM_STORAGE_MEM
                bool "Memory storage backend"
                default y
                help
                  使用RAM存储图片，访问快速，断电丢失

            config ENABLE_IMAGE_ALBUM_STORAGE_SD
                bool "Filesystem storage backend (SD/Flash)"
                default n
                help
                  使用文件系统存储图片（SD卡/Flash），断电保留
        endif
    endif
endif
```

## src/wukong/toolkits/mcp/Kconfig
```kconfig
# MCP Toolkits Configuration
# Sourced from: src/wukong/mcp/

menuconfig ENABLE_TUYA_TOOLKITS
    bool "Enable MCP toolkits"
    help
      启用MCP工具集，为AI提供设备控制和扩展能力

if ENABLE_TUYA_TOOLKITS
    if ENABLE_TUYA_CAMERA
        config ENABLE_TOOLKITS_CAMERA
            bool "Camera toolkit"
            default n
            help
              AI可调用摄像头进行拍照/识别
    endif
    if T5AI_BOARD_ROBOT
        config ENABLE_TOOLKITS_MOTION
            bool "Motion control toolkit"
            default n
            help
              AI可控制机器人运动（仅机器人板）
    endif
    if T5AI_BOARD_DESKTOP
        config ENABLE_APP_MOTION_ROTATION_MCP
            bool "Motion rotation toolkit"
            default y
            help
              启用旋转/运动传感器MCP工具（仅桌面版）
    endif
    config ENABLE_TOOLKITS_TM
        bool "Time management toolkit"
        default n
        help
          AI可进行时间管理（日程、提醒等）
    config ENABLE_TOOLKITS_CONTROL
        bool "Device control toolkit"
        default y
        help
          AI可控制设备基础功能（音量、亮度等）
    config ENABLE_TOOLKITS_SYSTEM
        bool "System info toolkit"
        default y
        help
          AI可查询设备系统信息（时间、运行时长、内存）
    config ENABLE_TOOLKITS_SKILL
        bool "Skill toolkit (fs .md skills + read_skill)"
        default n
        help
          AI可读取SD卡上的 .md 技能并按需加载(read_skill)编排常驻工具
    config ENABLE_TOOLKITS_MEMORY
        bool "Memory toolkit (long-term memory)"
        default n
        help
          AI可读写用户长期记忆(memory_get/save/update/delete)
    config ENABLE_TOOLKITS_PLAYBACK
        bool "Audio playback toolkit"
        default n
        help
          AI可控制音频播放（播放、暂停、切换等）
    config ENABLE_TOOLKITS_IMM
        bool "Instant messaging toolkit"
        default n
        help
          AI可进行即时通讯（发送消息等）
    config ENABLE_TOOLKITS_SOCIAL
        bool "Social interaction toolkit"
        default n
        help
          AI可使用社交功能（好友互动等）
endif
```

## src/wukong/video/Kconfig
```kconfig
# Video Configuration
# Sourced from: src/wukong/video/

menu "Video Configuration"
    choice
        prompt "Video input source"
        default USING_CAMERA_VIDEO_INPUT if ENABLE_TUYA_CAMERA
        default USING_NONE_VIDEO_INPUT

        config USING_NONE_VIDEO_INPUT
            bool "None"
            help
              无视频输入源。依赖视频的业务（P2P视频、预览、拍照、移动侦测等）
              在运行时自动降级（接口返回不支持，不会崩溃）

        config USING_CAMERA_VIDEO_INPUT
            bool "Camera (tal_camera)"
            depends on ENABLE_TUYA_CAMERA
            help
              以板载摄像头（tal_camera驱动）作为视频输入源，
              硬件配置来自板级 tuya_board_get_camera_cfg()
    endchoice
endmenu
```
